## toolchain/toolchain-bare-metal-buildroot/Config.in
```kconfig
if BR2_TOOLCHAIN_BARE_METAL_BUILDROOT

config BR2_TOOLCHAIN_BARE_METAL_BUILDROOT_ARCH
	string "list of architecture tuples"
	help
	  This option allows to define the list of architecture
	  tuples for which bare-metal toolchains will be created.
	  One toolchain will be built for each of the architecture
	  tuples specified in this option.

	  For example, to build both a Microblaze and a RISC-V bare
	  metal toolchain, use the following definition:
	  "microblazeel-buildroot-elf riscv32-buildroot-elf"

config BR2_EXTRA_GCC_BARE_METAL_CONF_OPTIONS
	string "Additional bare-metal gcc options"
	default ""
	help
	  Any additional bare-metal gcc configure options you
	  may want to include. Affects al architecture tuples
	  specified in BR2_TOOLCHAIN_BARE_METAL_BUILDROOT_ARCH.

source "package/newlib-bare-metal/Config.in"

endif # BR2_TOOLCHAIN_BARE_METAL_BUILDROOT
```
